## modules/reference/hardware/jetpack/nvidia-jetson-orin/virtualization/common/dce-virt-common/sources/drivers/platform/tegra/dce-guest-proxy/Kconfig
```kconfig
# SPDX-License-Identifier: GPL-2.0-only
config TEGRA_DCE_GUEST_PROXY
	bool "Tegra DCE guest proxy support"
	help
	  Redirects the guest DCE driver's client IPC through a shared MMIO
	  window to a QEMU bridge, which relays it to the real, host-owned DCE.

	  Say Y here to enable this driver and to compile this driver as a
	  module, choose M here. If unsure, say N
```

## modules/reference/hardware/jetpack/nvidia-jetson-orin/virtualization/common/dce-virt-common/sources/drivers/platform/tegra/dce-host-proxy/Kconfig
```kconfig
# SPDX-License-Identifier: GPL-2.0-only
config TEGRA_DCE_HOST_PROXY
	bool "Tegra DCE host proxy support"
	help
	  Exposes the DCE client IPC (CPU_RM interface) to the user level,
	  in order to relay a guest's DCE display IPC to the real,
	  host-owned DCE.

	  Say Y here to enable this driver and to compile this driver as a
	  module, choose M here. If unsure, say N
```
